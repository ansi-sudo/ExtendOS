## meta-extendos/conf/distro/extendos.conf
```bitbake
require conf/distro/superbird.conf

DISTRO = "extendos"
DISTRO_NAME = "ExtendOS"
DISTRO_VERSION = "0.1.0"

# identity / brand. override per your product.
SUPERBIRD_HOSTNAME = "extendos"
SUPERBIRD_MDNS_SERVICE_NAME = "ExtendOS"
SUPERBIRD_USB_GADGET_NAME = "extendos"
SUPERBIRD_USB_GADGET_MANUFACTURER = "extendos"
SUPERBIRD_USB_GADGET_PRODUCT = "ExtendOS"
```

## meta-extendos/conf/layer.conf
```bitbake
BBPATH .= ":${LAYERDIR}"
BBFILES += "${LAYERDIR}/recipes-*/*/*.bb ${LAYERDIR}/recipes-*/*/*.bbappend"

BBFILE_COLLECTIONS += "extendos"
BBFILE_PATTERN_extendos := "^${LAYERDIR}/"
BBFILE_PRIORITY_extendos = "20"

LAYERVERSION_extendos = "1"
LAYERSERIES_COMPAT_extendos = "scarthgap wrynose"
LAYERDEPENDS_extendos = "core superbird meson chromium-browser-layer"
```
